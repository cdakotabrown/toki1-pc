/* Generated by pc/tools/gen_missing_globals.py: typed alias views of globals.
 * Each view is the SAME object as its D_<ADDR> base (linker-script symbol
 * assignment; pc/Makefile passes this file to the link). */
PROVIDE(now_icon_c = D_800EF7F3);
PROVIDE(kuchi_stop_w = kuchi_stop);
PROVIDE(mes_base_y_h = D_8012DD10);
PROVIDE(D_800B1746_v = D_800B1746);
PROVIDE(anim_fade_v = D_800BC0C8);
PROVIDE(D_800BC0C8b = D_800BC0C8);
PROVIDE(D_800BCC48b = D_800BCC48);
PROVIDE(D_800BCC4Cb = D_800BCC4C);
PROVIDE(D_800BCC50b = D_800BCC50);
PROVIDE(D_800BCC58b = D_800BCC58);
PROVIDE(_sys_default_tpage_set_tbl0_w = D_800CC4CC);
PROVIDE(mascot_init_tbl0_w = D_800CC4D4);
PROVIDE(mascot_init_tbl1_w = D_800CC510);
PROVIDE(mascot_init_tbl2_s = D_800CC514);
PROVIDE(D_800D07EC_b = date_place);
PROVIDE(D_800EE760_b = D_800EE760);
PROVIDE(D_800EE79E_c = D_800EE79E);
PROVIDE(now_year_b = D_800EE79E);
PROVIDE(now_year_v = D_800EE79E);
PROVIDE(now_month_v = D_800EE79F);
PROVIDE(para_tai_a = D_800EE85E);
PROVIDE(reserved_date_lo = D_800EECAC);
PROVIDE(bukatu_pt6_w = bukatu_pt6);
PROVIDE(schedule_cursor_v = D_800EEE7C);
PROVIDE(D_800EF6BF_b = D_800EF6BF);
PROVIDE(now_girl_v = D_800EF6BF);
PROVIDE(step_counter_v = D_800EF864);
PROVIDE(now_sub_sub_step_v = D_800EF86A);
PROVIDE(step_mode_v = D_800EF86D);
PROVIDE(D_800EFD9C_b = D_800EFD9C);
PROVIDE(D_801258DC_v = D_801258DC);
PROVIDE(D_801271B0_a = D_801271B0);
PROVIDE(D_801271B0_b = D_801271B0);
PROVIDE(class_w_r = D_801271B0);
PROVIDE(D_801273D0_a = D_801273D0);
PROVIDE(D_801273D0_b = D_801273D0);
PROVIDE(bustup2_cw_bright_v = D_801279F3);
PROVIDE(D_80128B30_b = cw96_active);
PROVIDE(D_80128B30_c = cw96_active);
PROVIDE(cal_cw_bright_v = D_80128B37);
PROVIDE(cw97_bright_v = D_80128B7B);
PROVIDE(D_80129C30_b = D_80129C30);
PROVIDE(D_8012A5B4_b = bg0_x);
PROVIDE(D_8012A5C0_b = bg0_r);
PROVIDE(D_8012A5D8_b = bg1_x);
PROVIDE(D_8012A5E4_b = bg1_r);
PROVIDE(coord_buf_r = coord_buf);
PROVIDE(work_fuku_v = work_fuku);
PROVIDE(gSDInfo_frame = D_8012DD80);
PROVIDE(date2_wait_cnt_v = D_8013A5AC);
PROVIDE(D_8013C57C_b = D_8013C57C);
PROVIDE(D_8013C57C_c = D_8013C57C);
PROVIDE(D_8013C57C_d = D_8013C57C);
PROVIDE(shugaku_cw97_res_aux_s = D_8013CA8C);
PROVIDE(shougatu_meet_now_serifu_v = D_80143BC0);
PROVIDE(D_80147244_v = D_80147244);
PROVIDE(D_801493F8_b = D_801493F8);
PROVIDE(taiiku_tama_gclk_v = D_80149B92);
PROVIDE(D_8014D194_a = D_8014D194);
PROVIDE(tt_game_wk_v = D_80158A70);
PROVIDE(screen_w_b = D_800EE760);
PROVIDE(girl0_flag_b = D_800EE928);
PROVIDE(girl2_flag_b = D_800EE998);
PROVIDE(girl3_flag_b = D_800EE9D0);
PROVIDE(p_sei_b = D_800EE834);
PROVIDE(girl0_flag_lo = D_800EE928);
PROVIDE(tt_config_flags_b = D_800F022D);
PROVIDE(cw96_active_a = cw96_active);
PROVIDE(srn_w_a = D_80129C30);
PROVIDE(now_date_spot_b = now_date_spot);
PROVIDE(tt_config_flags_u = D_800F022D);
PROVIDE(now_icon_u = D_800EF7F3);
PROVIDE(pad_trig_w = D_800EF6E8);
PROVIDE(now_icon_b = D_800EF7F3);
PROVIDE(step_counter_u = D_800EF864);
